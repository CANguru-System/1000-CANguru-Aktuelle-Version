#include <Arduino.h>
#include <WiFiClient.h>
#include <HTTPClient.h>
#include <Update.h>
#include <WiFi.h>
#include <esp_wifi.h>
#include <esp_now.h>
#include "esp_ota_ops.h"
#include "esp_partition.h"
#include "Core_Ota.h"
#include "Core_EspNow.h"
#include "protocol_constants_core.h"
#include "Core_Config.h"
#include "Core_Param.h"
#include "Core_Logging.h"
#include "Core_globals.h"
#include "DecoderBase.h"

volatile bool otaRequested = false;
bool otaInProgress = false;
bool otaRunning = false;

const char *OTA_URL = "http://192.168.4.1/firmware.bin";
// OTA WLAN of the bridge (WPA2). ota_wlan.h is generated by alles-bauen.ps1 from the local
// file 0300-Constants/ota_wlan.local.txt and is not in git (public repository).
#if __has_include("ota_wlan.h")
#include "ota_wlan.h"
#else
#error "ota_wlan.h fehlt: einmal alles-bauen.ps1 ausfuehren (erzeugt das OTA-WLAN-Passwort)"
#endif
const char *OTA_SSID = CG2_OTA_WLAN_SSID;
const char *OTA_PASS = CG2_OTA_WLAN_PASS;

// Verbindung zum WLAN der Bridge. Direkt auf dem bekannten Kanal (keine Suche über alle
// Kanäle) und mit bis zu drei Versuchen: beim Serien-OTA kam der zweite Decoder mit einem
// einzigen Versuch gelegentlich nicht ins WLAN.
static bool connectToBridgeAP()
{
    WiFi.mode(WIFI_MODE_STA);
    WiFi.persistent(false);

    // Sleep AUS – sonst fliegt er bei großen Transfers gerne raus
    WiFi.setSleep(false);

    const uint8_t attempts = 3;
    const unsigned long attemptMs = 8000;
    for (uint8_t attempt = 1; attempt <= attempts; attempt++)
    {
        Serial.printf("DECODER: Verbinde mit AP %s (Kanal %d), Versuch %u\r\n", OTA_SSID, BRIDGE_AP_CHANNEL, attempt);
        WiFi.begin(OTA_SSID, OTA_PASS, BRIDGE_AP_CHANNEL);
        coreRadioApplyTxPower(); // gilt auch für das OTA-WLAN

        unsigned long start = millis();
        while (WiFi.status() != WL_CONNECTED && millis() - start < attemptMs)
            delay(100);

        if (WiFi.status() == WL_CONNECTED)
        {
            Serial.print("DECODER: Verbunden, IP: ");
            Serial.println(WiFi.localIP());
            return true;
        }
        // Status für die Fehlersuche: 1 = AP nicht gefunden, 4 = Verbindung abgelehnt, 6 = getrennt
        Serial.printf("DECODER: keine Verbindung (Status %d)\r\n", (int)WiFi.status());
        WiFi.disconnect(false, true);
        delay(500);
    }
    Serial.println("DECODER: WiFi-Verbindung fehlgeschlagen");
    return false;
}

// Nach einem OTA-Fehler ist ESP-NOW abgebaut und das WLAN im Station-Modus.
// Ein Wiederaufbau im laufenden Betrieb hat sich als unzuverlässig erwiesen
// (Callbacks und Peer fehlten, der Decoder war danach taub). Deshalb sauber neu
// starten: ID und Bridge-MAC bleiben erhalten, der Decoder meldet sich per REJOIN
// zurück und teilt dabei mit, dass das Update fehlgeschlagen ist.
static void restartAfterOtaFailure(uint8_t code, const char *reason)
{
    Serial.printf("DECODER: OTA fehlgeschlagen (%s) - Neustart, Firmware bleibt unverändert\r\n", reason);
    Update.abort();
    prefs.putByte(key_id, aliveGetDecoderID());
    prefs.putByte(key_otaFailed, code); // Grund wird mit REJOIN gemeldet
    coreConfigSetOtaPending(true);
    delay(500);
    ESP.restart();
}

// Kopf einer ESP-Firmware: Byte 0 = 0xE9, Byte 12/13 = Chip-Kennung (Little Endian).
// Eine Firmware für einen anderen Chip würde nach dem Neustart nicht laufen; der Decoder
// wäre dann nur noch per USB zu retten (z. B. C3-Firmware auf dem ESP32 des LED-Signals).
static bool firmwareFitsChip(const uint8_t *h)
{
#if defined(CONFIG_IDF_TARGET_ESP32C3)
    const uint16_t ownChip = 5;
#elif defined(CONFIG_IDF_TARGET_ESP32S3)
    const uint16_t ownChip = 9;
#elif defined(CONFIG_IDF_TARGET_ESP32S2)
    const uint16_t ownChip = 2;
#else
    const uint16_t ownChip = 0; // klassischer ESP32
#endif
    if (h[0] != 0xE9) {
        Serial.println("DECODER: Datei ist keine ESP-Firmware");
        return false;
    }
    uint16_t chip = h[12] | (h[13] << 8);
    if (chip != ownChip) {
        Serial.printf("DECODER: Firmware für Chip %u, dieser Decoder ist Chip %u\r\n", chip, ownChip);
        return false;
    }
    return true;
}

bool coreOtaStartFromBridge() {

    if (!connectToBridgeAP()) {
        restartAfterOtaFailure(CG2_OTA_FAIL_WIFI, "keine Verbindung zum WLAN der Bridge");
        return false;
    }

    esp_now_deinit();
    espNowReady = false;

    WiFiClient client;
    HTTPClient http;

    if (!http.begin(client, OTA_URL)) {
        restartAfterOtaFailure(CG2_OTA_FAIL_HTTP, "HTTP begin");
        return false;
    }

    int httpCode = http.GET();
    if (httpCode != HTTP_CODE_OK) {
        Serial.printf("DECODER: HTTP GET Code %d\r\n", httpCode);
        http.end();
        restartAfterOtaFailure(CG2_OTA_FAIL_HTTP, "HTTP GET");
        return false;
    }

    int contentLength = http.getSize();
    if (contentLength <= 0) {
        http.end();
        restartAfterOtaFailure(CG2_OTA_FAIL_HTTP, "ungültige Content-Length");
        return false;
    }

    if (!Update.begin(contentLength)) {
        http.end();
        restartAfterOtaFailure(CG2_OTA_FAIL_SIZE, "Update.begin");
        return false;
    }

    WiFiClient* stream = http.getStreamPtr();
    size_t written = 0;
    uint8_t buff[BlockSizeDecoder];

    otaInProgress = true;

    uint8_t header[16];
    size_t headerLen = 0;
    bool headerChecked = false;

    // Abbruch, wenn so lange keine Daten mehr kommen
    const unsigned long stallTimeoutMs = 10000;
    unsigned long lastData = millis();

    while (http.connected() && written < (size_t)contentLength) {
        size_t available = stream->available();
        if (available) {
            int toRead = available;
            if (toRead > (int)sizeof(buff))
                toRead = sizeof(buff);
            int read = stream->readBytes(buff, toRead);
            if (read > 0) {
                // Die ersten 16 Byte sind der Kopf der Firmware: passt sie zu diesem Chip?
                for (int i = 0; i < read && headerLen < sizeof(header); i++)
                    header[headerLen++] = buff[i];
                if (!headerChecked && headerLen >= sizeof(header)) {
                    headerChecked = true;
                    if (!firmwareFitsChip(header)) {
                        http.end();
                        restartAfterOtaFailure(CG2_OTA_FAIL_INVALID, "Firmware passt nicht zu diesem Chip");
                        return false;
                    }
                }
                size_t w = Update.write(buff, read);
                written += w;
                lastData = millis();
            //    Serial.print(".");
            }
        }
        else if (millis() - lastData > stallTimeoutMs) {
            Serial.println("DECODER: keine Daten mehr vom Server");
            break;
        }
        delay(1);
    }
    Serial.printf("DECODER: Firmware empfangen, Größe: %d von %d bytes\r\n", written, contentLength);

    if (written < (size_t)contentLength) {
        http.end();
        restartAfterOtaFailure(CG2_OTA_FAIL_DOWNLOAD, "Download unvollständig");
        return false;
    }

    coreConfigSetOtaPending(true);

    if (!Update.end()) {
        Serial.print("DECODER: Update.end() Fehler: ");
        Serial.println(Update.getError());
        http.end();
        restartAfterOtaFailure(CG2_OTA_FAIL_INVALID, "Update.end");
        return false;
    }

    if (!Update.isFinished()) {
        http.end();
        restartAfterOtaFailure(CG2_OTA_FAIL_INVALID, "Update nicht vollständig");
        return false;
    }

    Serial.println("DECODER: OTA erfolgreich, starte neu...");
    http.end();
    prefs.putByte(key_id, aliveGetDecoderID());
    delay(1000);
    ESP.restart();
    return true;
}

void coreOtaInit()
{
    // Flags sind bereits in coreEspNowInit zurückgesetzt
}

// Aufruf bei CG2_OTA_DECODER_START (nach der Quittung an die Bridge)
void coreOtaRequest()
{
    otaRequested = true;
    otaRunning = true;
}

void coreOtaLoop()
{
    if (otaRequested && !otaInProgress)
    {
        otaRequested = false;
        // Der Quittung an die Bridge Zeit lassen, dann ESP-NOW abbauen und per WLAN laden
        delay(100);
        esp_now_deinit();
        espNowReady = false;
        coreOtaStartFromBridge();
    }
}
